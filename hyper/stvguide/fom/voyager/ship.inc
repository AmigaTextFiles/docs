@DATABASE ship.inc
@NODE "ship"

@{" The U.S.S. Voyager "  SYSTEM "view pics/voyager.jpg"} 
@{" Blueprint          "  SYSTEM "view pics/voypla.jpg"} 


@{" Briefing Room      "  SYSTEM "view pics/briefin.jpg"} 
@{" Informations       "  SYSTEM "ppmore docs/briefin.txt"} 

@{" Engineering        "  SYSTEM "view pics/engenier.jpg"} 
@{" Informations       "  SYSTEM "ppmore docs/engenier.txt"}
 
@{" Holodeck           "  SYSTEM "view pics/holod.jpg"} 
@{" Informations       "  SYSTEM "ppmore docs/holod.txt"} 

@{" Main Bridge        "  SYSTEM "view pics/mainbri.jpg"} 
@{" Informations       "  SYSTEM "ppmore docs/mainbrid.txt"} 

@{" Mess Hall          "  SYSTEM "view pics/messhal.jpg"} 
@{" Informations       "  SYSTEM "ppmore docs/messh.txt"} 

@{" Sick Bay           "  SYSTEM "view pics/sickbay.jpg"}
@{" Informations       "  SYSTEM "ppmore docs/sickb.txt"} 

@{" Transporter Room   "  SYSTEM "view pics/transp.jpg"} 
@{" Informations       "  SYSTEM "ppmore docs/tr.txt"} 

@endnode

                



