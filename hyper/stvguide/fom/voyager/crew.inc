@DATABASE crew.inc
@NODE "crew"

@{" The Crew                   "  SYSTEM "view pics/crew.jpg"} 

@{" Captain Kathryn Janeway    "  SYSTEM "view pics/capt.jpg"} 
@{" Informations               "  SYSTEM "ppmore docs/kathjan.txt"} 

@{" Commander Chakotay         "  SYSTEM "view pics/chako.jpg"} 
@{" Informations               "  SYSTEM "ppmore docs/chacot.txt"} 

@{" Lieutenant Tuvok           "  SYSTEM "view pics/tuvoc.jpg"} 
@{" Informations               "  SYSTEM "ppmore docs/tuvok.txt"} 

@{" The Doctor                 "  SYSTEM "view pics/doc.jpg"} 
@{" Informations               "  SYSTEM "ppmore docs/doc.txt"} 

@{" Lieutenant B´Elanna Torres "  SYSTEM "view pics/belana.jpg"} 
@{" Informations               "  SYSTEM "ppmore docs/belana.txt"} 

@{" Lieutenant Tom Paris       "  SYSTEM "view pics/tompa.jpg"} 
@{" Informations               "  SYSTEM "ppmore docs/paris.txt"} 

@{" Ensign Harry Kim           "  SYSTEM "view pics/harry.jpg"} 
@{" Informations               "  SYSTEM "ppmore docs/harry.txt"} 

@{" Kes                        "  SYSTEM "view pics/kes.jpg"} 
@{" Informations               "  SYSTEM "ppmore docs/Kes.txt"} 

@{" Neelix                     "  SYSTEM "view pics/neelix.jpg"} 
@{" Informations               "  SYSTEM "ppmore docs/neelix.txt"} 









@endnode

                



