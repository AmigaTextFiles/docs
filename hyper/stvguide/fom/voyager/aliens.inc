@DATABASE aliens.inc
@NODE "aliens"


Already on this journey, the U.S.S. Voyager has encountered new life forms, 
discovered a mysterious phenomenon, 
and has joined forces with a militant group. 
You may learn about these encounters by 
viewing abstracts from the Voyager Mission Library.




Ocampa 

This alien species, mysteriously protected by the Array, 
has a life span of only nine Ocampa years. 
Several hundred thousand Ocampa reside miles underground a hot, desert planet, 
where they have lived for over a thousand years. 
Their below-the-surface habitat originated when the mysterious global warming 
began, 
and their planet turned into a desert. 
It was at this time that the Caretaker ordered the Ocampa to leave the 
surface to find refuge and an abundance of water underground -- with strict 
instructions never to return to the surface again.



Talaxian 

From a part galaxy never explored before, 
The Talaxians and the Haakonians had been at war for some time when the 
Haakonians 
used a weapon called the Metreon Cascade to wipe out the entire Talaxian moon of 
Rinax. 
The Talaxians were conquered by the Haakonians in 2356.


Kazon 

The crew members of Starship U.S.S. Voyager first encounter this sinister new race 
on the surface of the planet-turned-desert. They are warriors who have made 
frequent attempts to invade the tunnels leading down to the Ocampa, in search of 
water.
The Kazon Collective is made up of a number of sects, one of the most violent of 
which 
is the Kazon-Nistrim. Kazon-Nistrim ships travel to various parts of the Delta 
Quadrant.



Maquis 


A militant group formed when a new treaty dividing territory between 
the Federation and Cardassians left several Federation colonies caught 
along the border in the newly established Demilitarized Zone. 
Rather than move their entire community into Federation territory, 
many colonists chose to stay and reside within the jurisdiction of the 
Cardassian Empire, without the protection of Starfleet.
Thus, the inception of the Maquis -- a group of resistance fighters considered
outlaws by the Federation and Cardassia. 

With several small ships for pre-emptive strikes and retaliatory raids 
against the Cardassians, the Maquis welcome all volunteers. 
These fighters range from colonists, to former Starfleet officers who believe 
in their cause, to those who have been dismissed from Starfleet and seek 
consolation 
from the Maquis. Some call the Maquis heroes, others accuse them of adding to 
the mounting tension in the region.


Called the "Caretaker" by the Ocampa, 
the array is a mysteriously active piece of 
space hardware that pulls the Starship U.S.S. Voyager to the edge of the galaxy, 
hundreds of thousands of light years away from home. It orbits the solar system 
while sending out a variety of energy and energy pulses at measured intervals 
that are impenetrable by Starfleet sensors.


Sikarians 

A race of humanoids known throughout the Delta Quadrant for their hospitality,
the Sikarians were visited by the U.S.S. Voyager on Stardate 48642. The
Sikarians have an evolved view of the importance of the quality of life, and to
that end, they value stories above all else, considering them to be a crucial
part of every being. The Sikarians have a device called a spatial transponder
that folds space to send people or objects up to 40,000 light years away. But
their Canon of Laws states that they cannot share this technology.


Konar 

Trianic-based energy beings, the Konar are non-corporeal life forms that extract
the neural energy of other beings to sustain themselves. They live in a dark
matter nebula in the Delta Quadrant. On Stardate 48734, a Konar took over
Tuvok's body in an attempt to lead the U.S.S. Voyager into the nebula to extract
the crew's neural energy.


Vidiians 

The Vidiian Soldality is a race of aliens who are affected by the phage, a virus
that destroys the Vidiians genetic codes and cellular structures, consuming
their bodies. To combat the phage, the Vidiians have developed advanced medical
technologies enabling them to extract organs from other beings and incorporate
those organs into themselves.

The Vidiians also capture beings to use as workers to dig tunnels on various
planets and planetoids which the Vidiians inhabit. These slaves are used
because the phage makes the Vidiians too weak to do the work themselves. When
the workers lose their strength, the Vidiians extract their organs for their
use.

The Vidiians have encountered members of the U.S.S. Voyager crew on two
occasions, Stardates 48532 and 48784.


Vhnori 

A race of humanoids whose belief system centers on the fact that they enter the
"Next Emanation," a higher level of consciousness, when they die. They believe
that they will be reunited with deceased loved ones. Vhnori leave this life for
the Next Emanation voluntarily. The person is placed in a cenotaph which
transports the body through a subspace vacuole to a different area of space. On
Stardate 48623, the U.S.S. Voyager determined that the bodies release neural
energy after passing through the vacuole, and that energy becomes part of an
ambient electromagnetic field, supporting the Vhnori concept of the Next
Emanation.

First encountered in "<A HREF="/VoyagerMission109.html">Emanations</A>"


Romulans 

The Romulans are an Alpha Quadrant warrior race from the planets Romulus and
Remus. The Romulan Star Empire does communicate with the United Federation of
Planets. On Stardate 48579, the U.S.S. Voyager used a collapsing wormhole to
contact Romulan scientist Telek R'Mor. But the wormhole was a gateway through
time as well as space, so the U.S.S. Voyager was speaking with Telek R'Mor from
19 years in his future.


Baneans 

A race of people who live in the Delta Quadrant, the Baneans are at war with
another race, the Numiri, even though the two races once co-existed on one
planet. Baneans have the technology to extract memory engrams from the dead,
providing an account of how they died. The engrams are used in murder trials. 
Banean punishment for murder is an implant which causes the killer to repeatedly
experience the event through the victims eyes.


Numiri 

Although the Numiri once co-existed on the same planet with the Baneans, the two
Delta Quadrant races are now at war. Numiri patrol ships regularly intimidate
visitors to the Banean homeworld, and Numiri society is considered to be very
covert. Numiri patrols engaged the U.S.S. Voyager in 2371 while that ship was
visiting the Baneans.


Haakonians 

The Haakonians counquered the Talaxian homeworld in 2356. The
day after the Haakonians initiated a Metreon Cascade on the Talaxian moon of
Rinax, Talax surrendered unconditionally.


@ENDNODE

