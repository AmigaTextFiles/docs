@DATABASE Story1.inc
@NODE "Story1"

Die Geduld des Boba Fett
-------------------------------------
                      by Patrick Henz

Seit Stunden saß er nun im Cockpit seiner SLAVE 1 und wartete, daß 
irgendetwas passieren würde. Warten war oftmals das Beste was ein
Kopfgeldjäger machen konnte, und Boba Fett war schließlich die Nummer eins unter 
ihnen. Das war auch mit ein Grund warum das Imperium seine Mithilfe wollte. Um 
sich was die Zeit zu verkürzen hatte er ein Spiel in seinen Bordcomputer geladen. 
Nach gut zwei Stunden Spielzeit war er nun kurz davor einen neuen absoluten 
Highscore aufzustellen, doch es sollte ganz anders für ihn kommen. 
"Gleich hab ichs... was? Nein!" Das Spiel verschwand vom Bildschirm und stattdes-
sen erschien ein imperialer Offizier. "Ich höre.", knurrte Boba. "Das Imperium hat die 
Suche aufgegeben, es scheint als hätte der Falke es doch irgendwie geschafft in 
den Hyperraum zu kommen." Fett wußte das dies nicht stimmen konnte. Die Falcon 
war ein gutes Schiff, aber es konnte trotzdem keine Wunder vollbringen und außer-
dem hatte sein neues Spielzeug auch nichts angezeigt. Der Belohnung wegen wollte 
er seine Gedanken aber nicht seinem Gesprächspartner offenbahren. "Die Flotte 
wird jetzt standardgemäß den Müll ablassen und dann in den Hyperraum gehen." 
Das standardgemäß ließ Boba aufhorchen. Er wußte noch nicht wie Solo es ge-
macht hatte, aber es mußte mit dem standardgemäß zusammenhängen. "Dann wer-
de ich jetzt den Hangar verlassen und hier mit meiner Suche 
beginnen.", antwortete er dem Offizier. Zusammen mit dem Müll verließ auch die 
SLAVE 1 den Sternzerstörer. Der Kopfgeldjäger achtete penibel darauf, daß er nah 
genug mit seinem Schiff an einem großen Wrackteil blieb, damit die Chance seiner 
Entdeckung möglichst gering blieb. Die Flotte verschwand in den Hyperraum, noch 
war nichts von dem Millennium Falcon zu entdecken. Sollte sein Instinkt doch ver-
sagt haben? Nein, da sah er die Falcon auf den Schirm. Sie zündete gerade ihre 
Triebwerke um davon zu fliegen. "Niemand kann Boba Fett entkommen." und dann 
grinste er. Es war ein diabolisches Grinsen, denn Solo war in eine Falle getappt. 
Boba betrachtete seinen Computerscreen, der Hyperspace-Analyzer, ein kleines 
Geschenk von Jabba dem Hutten, rechnete noch und ein paar Sekunden später 
konnte der Jäger die Richtung ablesen, in der die Falcon geflogen war. Fett ließ nun 
den Computer untersuchen welche Systeme in dieser Richtung lagen. Das Pro-
gramm nannte Bespin zuerst. "Hmm, mal sehen was wir noch über Bespin wissen.", 
er  tippte wieder was ein, um in die Schiffsdatenbank zu kommen. "Aha, eine 
Tibanna Gas Mine, Administrator ist... Administrator ist Lando Calrissian. Gotcha! 
Das ist also dein Ziel, Solo. Ich glaube da wirst du noch eine kleine Überraschung 
erleben!" Er verständigte noch die imperiale Flotte und machte sich dann ebenfalls 
nach Bespin auf. Wenn man das Letzte aus der SLAVE 1 herausholte war sie sogar 
noch schneller als die Falcon. Boba Fett tat dies.

  
  "The Boba Fett-Experience" is a fan-produced programm.  
  We do not want intend to infringe upon rights
  of any other copyright holder. All rights revert to the
  contributor upon publication.


@ENDNODE

