@DATABASE Story4.inc
@NODE "Story4"

Kopfgeld (by Roland Theis)

"Verdammt jung!", dachte Boba Fett. Er stand über dem toten Jawa, die beiden Son-
nen brannten vom Himmel. Früher hätte er was gefühlt, irgendetwas, Mitleid, Trauer, 
oder wenigstens nur das geringste Mitgefühl. Doch mittlerweile war er kalt gewor-
den. Fett begann manchmal Angst vor sichselbst zu kriegen, wenn er nach dem tö-
ten sowas wie Befriedigung fühlte. Doch nicht bei dem Jawa. Es war zu einfach ge-
wesen, zu wehrlos war das Wesen. Es hatte versucht einen Haufen Schrott Jabba 
als Droiden zu verkaufen. Wenn Jabba was nicht ausstehen konnte, war es wenn 
jemand versuchte ihn zu betrügen. Der Hutte fürchtete so seine Autorität zu verlie-
ren, darum wurde der Jawa ein Fall für Fett. 
Mühelos hob er den Leichnam auf und legte ihn in den offenen Gleiter. Jabba würde 
das Kopfgeld zahlen.

  
  "The Boba Fett-Experience" is a fan-produced programm.  
  We do not want intend to infringe upon rights
  of any other copyright holder. All rights revert to the
  contributor upon publication.


@ENDNODE
