@DATABASE Zeit.inc
@NODE "Zeit"


Die Star Wars-Zeittafel
-----------------------
    last edit 22.6.1997


    -5 Jahre  Buch: Lando Calrissian - Rebell des Sonnensystems
              Buch: Die Abenteuer von Han Solo
              @{" Kopfgeld " link Story4.inc/Story4}

    +0 Jahre  Film: Krieg der Sterne
              Zerstörung des 1.Todessterns in der Schlacht von
              Yavin

    +3 Jahre  Film: Das Imperium schlägt zurück
              Schlacht von Hoth
              @{" Die Geduld des Boba Fett " link Story1.inc/Story1}

    +4 Jahre  Film: Die Rückkehr der Jedi-Ritter
              @{" Boba Fett lebt! " link Story2.inc/Story2}
              Gründung der Neuen Republik
              



Quellen: -Star Wars Insider No.23
         -A Guide to the Star Wars Universe
         -Star Wars Sourcebook

Collected by Solo.


@ENDNODE
  


