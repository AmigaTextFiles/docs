@DATABASE Bett.inc
@NODE "Bett"

Das Bett
--------------------------------
                 by Patrick Henz

Theodor Scott betrat das Hotel. Eigentlich war er Hotels 
gewohnt, als Handelsvertreter für Staubsauger schlief er fast 
zwei Drittel des Jahres in Hotels, doch diesmal war es anders. 
Der Umstand war anders, er war nicht wie üblich auf 
Geschäftsreise, seine Ehe war in die Brüche gegangen und er 
mußte sein Zuhause aufgeben. 
Die alte Dame an der Rezeption gab ihm den Schlüssel für das 
Zimmer. Es war ein kleines und altes Hotel, aber gut 
gepfegt, genauso wie sein Zimmer. Da Theodor müde war ging er 
früh zu Bett und er schlief auch sofort ein. Sein Schlaf war 
tief und traumlos.

Die ersten Sonnenstrahlen fielen durch das Fenster und 
Theodor Scott wachte auf, ging in das Badezimmer und rasierte 
sich, als er seine rechte Hand sah, war er sehr überrascht. 
Sein Ehering war fort. Bei den Streits mit seiner Frau hat er 
mehrmals versucht den Ring abzunehmen und ihn ihr vor die Füße 
zu werfen, aber es gelang ihm nicht. Er suchte das Zimmer und 
dann das Bett ab. In einer Ritze des Bettes fand er den Ring 
auch schließlich, erleichtert spülte er ihn die Toilette 
herunter. Der Rest des Tages verlief für Theodor belanglos. 

Diese Nacht sollte er träumen, er träumte wie er seine Frau 
von hinten erstach. Bis dahin wußte er nicht, wie sehr er sie 
haßte. Sie hatte sein geordnetes Leben zerstört. Aber es war 
nur ein Traum, im richtigen Leben konnte er niemanden töten. 

Am nächsten Morgen wurde Scott nicht von der Sonne, sondern 
von einem Klopfen an der Tür geweckt. Es war die Polizei, 
seine Frau wurde erstochen. Es gab keine Zeugen, nur Theodors 
Fingerabdrücke waren auf dem Messer zu finden. Er war nicht 
der Mörder, doch starb er fünf Jahre später auf dem elektrischen 
Stuhl.


Diese Geschichte beruht auf einer wahren Begebenheit.
 

@ENDNODE


