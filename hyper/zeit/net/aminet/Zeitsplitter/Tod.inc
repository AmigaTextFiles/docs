@DATABASE Tod.inc
@NODE "Tod"

Tod mit 30 Jahren
*****************************************
               Copyright by Patrick Henz.

Geburt
------
Es war ein erhebender Augenblick. Trotz seines noch jungen 
Lebens konnte Richard gleich nach seiner Geburt schon alles 
warnehmen. Er lag jetzt im Bett, direkt neben seiner Mutter. 
"Na mein Kleiner.", sagte sie zu ihm. "Genieße dein Leben, denn 
mit 30 wirst Du sterben." Ungewöhnlich Worte für ein 
Neugeborenes. Richard dachte noch lange über sie nach, kam aber 
zu keiner vernünftigen Lösung, aber schließlich war er auch 
gerade erst geboren worden, er hatte noch sein ganzes Leben 
vor sich.

7 Jahre
-------
Es war eine seltsame Feier. Richard und seine Familie waren 
extra hierfür von der Venus zur Erde gereißt. Seine Mutter sagte 
zu ihm, daß es Onkel Williams Todesfeier wäre. Aber das war 
unlogisch, Rick kannte ihn, William war jung und gesund: Heute 
war sein Geburtstag, sein 30. Geburtstag! Bedrückend war die 
Stimmung, alle Gäste waren in schwarz gehüllt, nur einer trug 
einen festlichen weißen Anzug: sein Onkel. Im Laufe des 
Abends bekam Rick auch die Gelegenheit mit ihm zu sprechen. 
Um ungestörter zu sein gingen die beiden in den Garten. Die 
beiden Monde schienen an dem blutroten Himmel. "Onkel, mußt Du 
wirklich schon sterben?", fragte er William. "Ja und nein.", 
antwortete dieser, "Einerseits werde ich in zweieinhalb 
Stunden sterben, andererseits fange ich dann erst an zu Leben, 
denn nach dem Tod wird es wieder ein Leben geben. Ein anderes 
Leben wie hier, aber ein Leben." Auch diese Worte verstand 
Richard nicht, aber er war ja auch erst sieben, er hatte sein 
ganzes Leben noch vor sich. 
Das komische am Tod war, daß man ihn auf die Sekunde genau 
vorherrechnen konnte. 23:07:42 sollte die Todeszeit für Onkel 
William sein. Kurz vorher bildete man im Garten einen Kreis. In 
der Mitte Richards Onkel. Eine Minute vor der Todeszeit faßten 
sich alle Gäste an den Händen an und fielen in einen 
düsteren Gesang ein. Auf die Sekunde genau war es dann 
soweit: Onkel William löste sich auf und verschwand aus 
dieser Welt. Die Feier war vorbei. Rick konnte im Hintergrund 
noch das leise Fauchen eines Drachen hören.

14 Jahre
--------
Mit seinen Gedanken war Richard auf den Jupitermond Europa 
gereißt. Hier wollte er eine Woche seiner Sommerferien 
verbringen. Er saß an einer einsamen Lagune. Ungefähr eine 
Stunde verbrachte er so an dem warmen Meer, als er 
plötzlich erschrak, aus dem Meer tauchte nämlich ohne 
Vorwarnung eine Gestalt auf. Der Schreck saß aber nicht lange, 
denn das Wesen war wunderschön. Sie hatte lange grüne Haare, 
schwarze Augen und eine blaueschimmernde Haut, aber vollallem 
hatte sie statt zwei Beinen einen Fischschwanz. Richard 
schätzte, daß sie in seinem Alter sein müßte. "Hallo 
Sternenkind!", begrüßte sie ihn freundlich. Es wurde eine 
sehr schöne Woche fuer ihn, denn er genoß das Leben.

21 Jahre
--------
Nichts ist schöner als die Geburt eines Sternes. Ein Jahr reißte 
er nun kraft seiner Gedanken durch das All, aber dieses 
Schauspiel faszinierte ihn immer wieder. Zusammen mit gut 
einem dutzend Fremdwesen befand er sich ungefähr eine Million 
Kilometer von dem neuen Stern entfernt im All. Er spürte die 
Wärme, die von dem Himmelskörper ausging. Er wünschte seine 
Mutter könnte ihn so sehen, denn er genoß das Leben.

28 Jahre
--------
Das Leben ging langsam zuende für ihn. Gesundheitlich fühlte 
er sich immer noch topfit, aber es gab sowieso keine 
Krankheiten, es hat sie nie gegeben und es wird sie auch 
niemals geben. Nur ein paar Einzelgänger hatten ihm mal von 
so etwas berichtet. Richard glaubte aber nur daß, was er 
selber sehen konnte. Zwei Jahre blieben ihm noch, denn mit genau 
30 Jahren verschwanden alle Menschen aus dieser Welt. Er 
wollte allein sein, deshalb verbrachte er diesen Tag in der 
Mitte eines schwarzen Lochs. Einstein hatte unrecht, auch hier 
verging die Zeit, er hörte das Ticken seiner Uhr.

Tod
---
Seine Todesfeier fand auf einer Insel namens Atlantis statt.
Richard fand, daß die vielen Ruinen ideal fuer die Zeremonie 
wären. Alle waren sie gekommen, seine Frau, seine Kinder, 
seine restliche Verwandschaft und seine Freunde. In der 
letzten Stunde dachte er an die süße Meerjungfrau, an die 
Geburt eines Sternes und an Onkel William. Hatte er damals 
recht gehabt? Gab es wirklich ein Leben nach dem Tod? Bald würde 
er es wissen. 14:43:59, er fing an sich aufzulösen und ihm 
wurde schwarz vor Augen. Eine absolute Schwärze umgab ihn, er 
hatte gelogen! Der Tod war endgueltig.
Knapp eine halbe Stunde befand er sich in diesem Zustand, dann 
fing er an im Hintergrund Stimmen zu hören. Plötzlich sah er 
ein grelles Licht. Es störte ihn, darum hielt er sich eine Hand 
vor die Augen. Langsam fing er an sich an das Licht zu gewönen. 
Es war ein künstliches Licht. Eine Lampe hing an der Decke. 
Richard entdeckte jetzt, daß er auf eine Art Bett lag, 
verschiedene Drähte befanden sich an seinem Körper. Ein Mann 
in einem weißen Kittel nahm sie jetzt ab. "Sie können gehen.", 
meinte er schließlich zu ihm. Rick stand auf und ging zur Tür. 
Draußen in dem Gang saß eine Frau, gut fünfzig Jahre alt, seine 
Mutter. "Komm!", sagte sie, "Wir müssen zu einer Geburtstagsfeier."
Es war seine Geburtstagsfeier. 30 Jahre war er wie alle Menschen 
im Cyberspace gewesen. Jetzt war er geboren worden. Als er mal 
eine Minute allein war ging er in den Garten. Etwas seltsames 
passierte, durch seine Nase drang irgendetwas in seinen Körper 
ein. Er bückte sich und bemerkte, daß der Auslöser hierfür 
eine kleine unscheinbare Blume war. Zum erstenmal nach 30 
Jahren konnte er riechen, und es war noch schöner als die 
Geburt eines Sternes. Ein Mann stand hinter ihm. Als Richard
sich umdrehte erkannte er seinen Onkel William.

@ENDNODE





