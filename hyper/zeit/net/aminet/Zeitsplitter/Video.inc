@DATABASE Video.inc
@NODE "Video"

-------------------------------------------------------------------------------
                          D A S   V I D E O S P I E L
-------------------------------------------------------------------------------


 Albert saß vor dem Fernseher, er sah aber nicht die x-te Wiederholung von
Kampfstern Galaktica oder eine sonstige Wiederholung, nein, er spielte PAC MAN,
sein absolutes Lieblingsspiel. Level acht und sein letztes Leben, Albert
steuerte PAC MAN nach rechts, hier waren die einzigen Videowaffeln die noch
übrig waren. Wenn er diese erreichte wäre er zum ersten Mal in neunten Level,
doch dazu kam es nicht mehr, ein Geist verschlung PAC MAN und damit Alberts
Highscore-Träume. "Albert", klang es aus dem Eßzimmer. Albert, wie er diesen
Namen haßte. Albert, so hießen alte englische Butler oder noch ältere deutsche
Wissenschaftler, aber nicht ein 12jähriger amerikanischer Junge. Sein Pech
war, daß sein Großvater so hieß. Aus alter Tradition nannte man in der Familie
jeden ersten Sohn nach seinen Großvater. "Ich komme schon.", antwortete er,
das Spiel war sowieso gerade aus. Nach dem Essen würde er es wieder versuchen.
 11 Uhr abends, nachdem Albert wieder den ganzen Tag PAC MAN durch das
Labyrinth gejagt hatte lag er nun in seinem Bett. Vor seinem geistigen Auge
sah er aber immernoch Labyrinthe, Geister, Videowaffeln und Powerpillen, morgen
würde er wieder auf Pillenjagd gehen, das wußte er genau, denn es waren
Sommerferien und die meißten seiner Freunde waren sowieso im Urlaub. Was
konnter man in einer Vorstadt alleine schon anderes machen außer PAC MAN zu
spielen?
 Er hatte diesen dauernden Hunger, Hunger nach Videowaffeln und Powerpillen.
Zum Glück lagen diese überall im Labyrinth haufenweise herum, er mußte diese
nur aufmampfen. Es wäre ein Leben im Paradies, würden nicht diese fiesen
Geister hier ihr Unwesen treiben. Der Hunger trieb ihn weiter. Die Waffeln
schmeckten einfach gut. Verdammt, da war schonwieder ein Gespenst hinter ihm,
aber er würde es einfach austricksen. Er lief auf der einen Seite aus den
Labryrinth raus und kam auf der gegenüberliegenden Seite wieder rein. Diese
dummen Geschöpfe fielen jedes Mal auf den alten Trick rein. Jetzt erspähte er
eine Powerpille in der Mitte des Labyrinths. Schnell mampfte er diese auf,
dann hörte er diese komisches Geräusch und gleichzeitig wurden die Gespenster
grau. Er jagte ihnen nach, denn auch graue Geister schmeckten gut und
außerdem war er ein richtiger Allesfresser. Zwei seiner Gegner konnte er
aufmampfen, als er sich den dritten genehmigen wollte, nahm dieser wieder seine
alte Farbe an, PAC MAN merkte dies zu spät, natürlich endete dieses
Zusammentreffen tödlich für den kleinen runden Kerl. Albert wachte auf. Was
für ein dummer Traum. Er träumte schon, daß er PAC MAN wär. Vielleicht hatten
seine Eltern doch recht, daß er zuviel vor dem Bildschirm hing. Egal, Albert
schlief ruhig wieder ein und diesmal träumte er nichts.
 11 Uhr vormittags, Albert war da wo er immer war. Level acht, wieder war er
kurz davor in den neunten Level zu kommen, noch vier Videowaffeln, keine
Gespenster würden ihn diesmal aufhalten können. Noch vier, drei, zwei,
eins,... Er hatte den achten Level bewältigt, doch anstatt wie sonst auch in
den nächsten Level zu gelangen wurde ihm schwarz vor Augen.
 Als er aufwachte lag er in einem Labyrinth. Er war am Bildschirm
eingeschlafen, denn es schien wieder der selbe Traum zu sein. Nicht ganz der
selbe Traum, diesmal war er nicht in die Rolle seines Lieblingshelden
geschlüpft, er war Albert geblieben. Allein war er nicht in seinem Traum,
gleich zwei Geister kamen von links, also rannte er nach rechts und sah sich
um. Der Abstand zwischen sich und den Gespenstern war etwas größer geworden.
Wie PAC MAN wollte er die Geister austricksen, rechts aus den Labryrinth
herauslaufen und dann links wieder reinkommen. PAC MAN konnte es, Albert
nicht. Er lief wie gegen eine unsichtbare Wand. Der Zusammenstoß tat ihm
ziemlig weh. Eigentlich komisch, denn in einem Traum hätte er nichts spüren
dürfen. Die Geister waren wieder ganz nahe. Albert konnte sich für oben oder
unten entscheiden. Er rannte nach oben, denn dort erblickte er seinen Freund
PAC MAN, PAC MAN würde ihm helfen können. Als er nach oben lief, bemerkte
Albert daß er auf einmal ganz gelb geworden war, das selbe gelb wie das der
Powerpillen. Es war wirklich ein ganz seltsamer Traum. PAC MAN lächelte wie
immer, er hatte den Jungen gesehen. "Jetzt bin ich gerettet.", dachte Albert.
PAC MAN kam auf ihn zu und mampfte ihn einfach auf, schließlich war er ein
richtiger Allesfresser.

Copyright 1993 by Patrick Henz.


@ENDNODE
