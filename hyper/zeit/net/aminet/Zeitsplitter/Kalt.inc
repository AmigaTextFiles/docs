@DATABASE Kalt.inc
@NODE "Kalt"

Der Kälteschläfer
-----------------------------------------
                          by Patrick Henz

Eine Geschichte aus dem EmPIRE-Universum.

Der Forschungskreuzer "Alsyn" hatte den Auftrag dieses Sonnensystem nach
möglichen Kandidaten für ein Terraformingprogramm zu untersuchen. Aber
eigentlich waren die Chancen gering, kein Planet befand sich in einer
günstigen Umlaufbahn um je menschliches Leben beherbergen zu können.
Aber um den Vorschriften gerecht zu werden mußte jeder Planet von dessen
Orbit aus gescannt werden. Commander Than II. hatte sich schon auf eine
ruhige Mission eingestellt, was schließlich auch seine Vorteile hatte.
Die "Alsyn" schwebte in den Orbit des vierten Planeten ein, es war ein
öder Wüstenplanet mittlerer Größe. Es würde also wieder ein ganzer
Erdentag vergehen, bis daß der Planet als unbrauchbar erklärt werden
könnte. Es lohnte sich noch nicht mal ihm einen Namen zu geben. 
"Comander, der Computer signalisiert eine Lebensform auf dem Planeten."
Es war der Wissenschaftsoffizier Ryan der dies sprach. Than schreckte aus
seinen Gedanken hoch. "Quelle näher bestimmen.", wies er Ryan an.
Ein paar Minuten später gab der Schiffscomputer weitere Details. Die
Quelle war zweifelsfrei menschlich, jedoch sehr schwach, als ob dieser
jemand kurz vor dem Tod stand. Aber es war schon unmöglich, daß 
man überhaupt auf diesem Planeten leben konnte. Die Durchschnittstemper-
atur lag bei 100 Grad Celsius und von Sauerstoff war auch keine Spur.
"Landetrupp bereitmachen. Wir werden uns das mal mit einer Landefähre
näher betrachten. Ryan sie kommen mit." 
Mit der Fähre landete das zehnköpfige Landungsteam nahe einer Pyramide.
Than II. wies zwei der Sicherheitsleute an das Shuttle zu bewachen, zwei
andere sollten am Eingang des Gebäudes warten. Tief in seinem Herzen
war er ein Abenteurer geblieben, wenn er auch derzeit nur langweilige
Forschungsmissionen leitete. Darum wollte es sich Than auch nicht nehmen
lassen, als erster in die Pyramide zu gehen. Es existierte nur eine 
leere riesige Halle, leer bis auf einen gläsernen Sarg, der in der
Mitte stand. Vorsichtig ging das Team vorwärts. Nein, es war kein
Sarg, es war eine Kälteschlafkammer. Ryan untersuchte mit einem kleinen
Computer das Ding inklusive seines Inhalts, einen ca. 30jährigen Mann.
"Mein Gott, der liegt schon seit 100 Jahren hier, aber er lebt." 
"100 Jahre lang im Kälteschlaf, auf was wartete er nur?", dachte Than.
Ein Tag später wachte der Schläfer auf der Krankenstation der "Alsyn"
auf. Noch war sehr geschwächt von Prozedur des Auftauens und es dauerte
noch einen weiteren Tag bis das er Than Antworten auf dessen Fragen
geben konnte. 
Gbalin stand vor dem Fenster seiner vorläufigen Kabine und starrte ins
All heraus. Mit einem Surren ging die Tür auf und der Commander des Schiffes
betrat das Zimmer. "Wie ich sehe sind sie schon wohl auf.", begrüßte
Than den Neuankömmling. "Dank ihrer Hilfe.", anwortete dieser. "Gut, dann
können sie mir ja auch jetzt sagen wer sie sind und auf was sie im
Kälteschlaf warten.", wurde der Commander direkter. "Warten...", murmelte
Gbalin in sich hinen und schaute weiter in die Sterne hinein. "Nein ich
warte nicht ich lebe, ich lebe im Schlaf." "Können sie das vielleicht
ein wenig präzisieren bat Than II. "100 Jahre Kälteschlaf", die Augen
des Schläfers fingen an zu leuchten, "Wissen sie ueberhaupt was das
bedeutet. 100 Jahre Schlaf sind 100 Jahre träumen. In dieser Zeit war 
ich an Orten, die sie niemals erreichen können. Ich habe Dinge gesehen
die es niemals gab und die es niemals geben wird. Dank der Kälteschlaf-
anlage kann ich mich in die Unendlichkeit träumen, dank ihr bin ich
unsterblich geworden, ewig träumen." Than war erstaund, so daß er
keinen vernünftigen Satz rausbrachte. "Außerdem wäre ich ihnen 
dankbar, wenn mich ihre Männer wieder auf den Planeten zurückbringen
könnten, er ist für sie sowieso ohne Bedeutung." 
Damit hatte Gbalin recht gehabt, Than ließ ihn deshalb wieder allein auf
den Wüstenplaneten zurück. Weil er nicht wußte wie die Bestimmungen
in diesem Fall anzuwenden waren, nahm er diesen Vorfall vorsichtshalber
aus seinem Bericht raus. Aber in einem hatte Gbalin unrecht, er war
nicht unsterblich, er blieb ein Mensch und wenn eines Tages sich diese
Sonne in einen roten Riesen verwandeln würde, würde er mit diesem
System untergehen, er würde im Schlaf sterben.


@ENDNODE

