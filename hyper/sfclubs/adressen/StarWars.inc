@DATABASE StarWars.inc
@NODE "StarWars"


            ________   ___   ____
           / __   __| / _ \ |  _ \
     ______> \ | |   |  _  ||    /_____________________________
    / _______/ |_|   |_| |_||_|\______________________________ \
   / /                                                        \ \
  | |                    Fa n c l u b s                        | |
  | |                         a l l                            | |
  | |                        o v e r                           | |
  | |                         t h e                            | |
  | |                       W o r l d                          | |
   \ \____________________________    _   ___   ____   _______/ /
    \___________________________  |  | | / _ \ |  _ \ / _______/
                                | |/\| ||  _  ||    / > \        LS
                                 \_/\_/ |_| |_||_|\_\|__/


last edit: 20.12.1995

GERMANY
*******

The Power of the Force
----------------------
Die Star Wars Saga geht in eine gigantische Zukunft und
als Mitglied im Official Star Wars Fan-Club (lizensiert
von Lucasfilm!) fliegt Ihr ganz vorn mit mit, wenn es sich
um aktuelle Infos, Hintergrundberichte, Insider-News sowie
kompetente Facts zur Kultsaga dreht!

Ca.400 Seiten Clubmagazin pro Jahr, umfangreichen
Materialverkauf, kostenlose Kleinanzeigen, regionale
und bundesweite Club-Treffen, Verlosungen, attraktive
Sonderbände, Club-Shirts, Buttons u.v.m.

Ausführliche Informationen zum OSWFC gibt es gegen
1.- DM in Briefmarken unter nachstehender Adresse.

-----------------------------------------------------
Official Star Wars Fan-Club

OSWFC
Postfach 11 04 07
86029 Augsburg
Germany


ITALY
*****

CLOUD CITY
----------
Saremmo onorati se vi uniste a noi...

I fans italiani della Saga cinematografica di Guerre Stellari 
hanno dato vita a Cloud City, la prima ed unica assoiciazione
culturale italiana dei fans di Star Wars.
Nel giro di cinque anni di attività, Cloud City é presto diventata
il punto di riferimento più attuale, puntuale, costante e completo
per quanti desiderano aggiornamenti tempestivi, informazioni e
curiosità sulle novità legate al mondo di Star Wars.
L´associazione, mettendo a disposizione degle appassionati
attività e iniziative a tutti i livelli, riesce a soddisfare sia
il semplice curioso alla ricerca di notizie e novità, sia il fan
più attivo e appassionato, desideroso di uno spazio in cui vedere
publicate le proprie produzioni: lettere, racconti, disegni.
L´iscrizone a Cloud City offre:
- Informazione
- Merchandising
- Narrativa e Disegno
- Contatti
- VHS
- Estero
- Manifestazioni
- Qualità:Cloud City è stat premiata con lo STARAWARS 1993,
           il premio Statunitense riservato ai migliori fan club
           e fanzine straniera dell´anno.

In Cloud City troverai sempre un "porto sicuro" dove attraccare
con la nave della Fantasia: avrai la sicurezza di poterti
immergere in un universo che offre il meglio die Guerre Stellari,
gestito nello spirito dei film e nel rispetto dei soci. Vola a
Cloud City, un porto sicuro per i fans die Guerre Stellari.

Cloud City
Cassella postale 771 AA/PP
06100 Perugia
Italy


USA
***

The Lucasfilm Fan Club
P.O.Box 111000
Aurora
Colorado 80042
U.S.A.

 

@ENDNODE







