@DATABASE StarTrek.inc
@NODE "StarTrek"

Star Trek-Clubs all over the World
-------------------------------------------------------
                                  last edit: 20.12.1995

Argentina
*********

 U.S.S. Francisco Gurruchaga NCC-4181
  Alejandro Lois
  Eduardo Huergo 1691
  (1682) Martin Coronado 3 de febrero
  Buenos Aires, Argentina


Austria
*******

 Galactic Friendship
  Karin Embacher
  Krottenbachstr.104/2/3
  A-1190 Wien
  Austria


Canada
******

 Trexperts
 c/o Valerie Herd
 7459 Nasrullah Crescent
 Niagara Falls
 L2H 2MA Canada

 U.S.S. Terra Nova
 R.R.3 Box 4-B
 PortauPort Peninsula
 Newfoundland, A0N 1T0
Canada


Germany
*******
 
  Klingon Strike Force
  c/o Jason Hulott
  Goethestr.18
  D-32457 Barkhausen, Germany

 Starfleet Delegation
  c/o Frank Fischer
 Hellensteiner Str.13
  D-63607 Wächtersbach, Germany

 Star Trek Central Europe
  Dirk Bartholomä
  Postfach 220111
  86181 Augsburg, Germany

 SFC
 c/o Michael Richert
 Schlangenbader Str.87
 1000 Berlin 33, Germany

 Starfleet /U.S.S.Europe NCC-1792
  Beate Gellings
  Oberdorferstr.31
  69124 Heidelberg
  Germany
 
 Star Trek Fan Club Enterprise Mannheim
  FCEM
  c/o Sylvia Strybuc
  Hans-Sachs-Ring 17
  68199 Mannheum, Germany

 Star Trek Fanclub
 c/o Nimo Grujic
 Triftstr.100
 D-33397 Rietburg
 Germany

 Star Trek Forum
 c/o Uschi Stockmann
 Otto-Heinrichs-Str.6
 D-38442 Wolfsburg, Germany

 Stak Trek-´The Next Generation´-Fanclub
 c/o Christopher M.Peckham
 Donnersbergring 35
 64295 Darmstadt
 Germany

 STI-Büro
 c/o Oliver Dreissigacker
 Bergheimer Str.120
 D-69115 Heidelberg
 Germany
 
 The Classic Connection
  c/o Ilona Schulz
  Brackelerstr.42
  D-44145 Dortmund, Germany

 The Final Frontier
  c/o Carsten Pohl
  Alfred-Ruppert-Str.1
  D-97828 Marktheidenfeld, Germany

 United Federation of Star Trek Fans
  USTF
  c/o Christine Mau
  Grandweg 120/508
  D-22529 Hamburg, Germany

 
Great Britain
*************

 DS9 England
  Dawn Tittley
  117 Dolwich Road
  Kingstanding, Birmingham
  B44 OEW, England

 The Neutral Zone
 60 Dovehouse Mead
 Berking, Essex IG11 7DU
 England

Greece
******

 Star Trek Fan Club of Athens, Greece
 45 Lefkados Str. Glyka Nera
 153-44, Athen, Greece


Italy
*****

 Star Trek Italian Club
 P.O.Box 28
 10048 Vinovo TO, Italy


 Südtiroler Star Trek-Fanclub
 Palermostr.48/11
 39100 Bozen/Südtirol, Italy


Nordireland
***********

 U.S.S. Destiny
  David Murphy
  12 Lagmore Downs
  Dunmurry BT 17 0XX
  Nordireland

  
USA
***

 Bajoran Republican Army
  B.R.A. Headquarters
  c/o Christine Shaw
  114 Broad Street-Suite 257
  Stamford, CT 06901, USA

 Star Trek:The Official Fan Club
 P.O.Box 111000
 Aurora, Colorado 80011
 U.S.A.

 The Romulan Web
 c/o W.Ray Settle
 12008 W.78th Terrace #6-G
 Lenexa, KS 66216, USA

 The Star Trek Pen Pal Connection
  Malcolm Gittins
  641 5th Avenue
  Coraopolis
  PA 15108
  USA

 U.S.S. Alliance NCC-2113
 P.O.Box 25277
 West LA, CA 90025-0277, USA






for fanpost:

c/o Star Trek Office
Paramount Pictures
5555 Melrose Avenue
Los Angeles, CA 90038, USA




@endnode



