@DATABASE Servant.inc
@NODE "Servant"

Sevant Droids


Name:
 SE4 Servant Droid
Model:
 Industrial Automaton SE4 Servant
Height:
 1.6 meters
Skills:
 Cultures
 Languages
 Culinary Arts
 Home Economics
Photo:
 @{"front-view" SYSTEM "view pics/SE4"}
Pic:
          ___
         /---\
        | @ @:|
        |  " :|
         \_-_/
       _.d._.b.__
   +"i\  |\_/|  /i"+
   [_| \ |   | / |_]
  .' |  ):===:(  | `.
  |:.'+-" | | "-+`.:|
  |_| |-. |_|   | |_|
  \:\ |-' /+\   ! |:|
   \ \|n._\+/_.n| / /
    \XT::::-::::T/ /
     "l-. `"' .-lXX
      |: \   / :|
      |:  i-i  :|
      |:  | |  :| LS
      |:  | |  :|
     \|;_ | |__;|/
      (__() ()__)      SE4 Servant Droid
      |:  | |  :|       - Front View -



@ENDNODE

