@DATABASE Espionage.inc
@NODE "Espionage"

Espionage Droids


Name:
 Spy-Eye
Model:
 Cybot Galacatica´s AC1 "Spy Eye"
Height:
 .7 meters in diameter
Skills:
 Dodge
 Sneak
 Search
Equipped with:
 Repulsor engine; max height 3 meters
 Visual range holocom with simultaneous transmitter
 Holo receiver unit; maximum range 500 meters
 Joystick controller; maximum range 500 meters
Photo:
 @{"front-view" SYSTEM "view pics/SpyEye"}
Pic:
             ___________
         _xXXXXXXXXXXXXXXXx_
       .-         |         -.
     _/___________|___________\_
    /             |       __    \
   / _____________|      /__\    \
  /               |      \__/     \
  |               |               |
   HHHHHHHHHHHHHHHHHHHHHHHHHHHHHHH
  |           |   |  ___   ___    |
  \           |   | |== | |==/    /
   \__________|   | |__| |__/    /
    \_________|___|_____________/
      \           |      /    /
       `-_________|_____/___-'  LS
              \. \|/ ./
                `-+-'
                  I
                 [ ]       AC1 "Spy-Eye" Surveillance Droid
              |==| |==]]            - Side View -
                 `-'


Name:
 Espionage Droid
Model:
 MerenData Espionage Droid (appears to be standard 3PO
 Human Relations Droid)
Height:
 1.7 meters
Weight:
 50 kilograms
Skills:
 Languages
 Cultures
Equipped with:
 Secondary Programming: Information recording and code-keyed
  retrieval/ broadcast system
 Vocabulator speech/sound system
 Broad-band antenna receiver
 AA-1 VerboBrain
 TranLang III Communication module (can access up to 
 seven million different languages)
Photo:
 @{"front-view" SYSTEM "view pics/C3PO"}


@ENDNODE

