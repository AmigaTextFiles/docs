@DATABASE Probe.inc
@NODE "Probe"

Probe Droids


Name:
 Probe Droid
Model:
 Arakyd Viper Probe Droid
Height:
 1.5 meters
Skills:
 Blaster
 Planetary Systems
 Search
Weapons:
 Blaster Cannon
Photo:
 @{"front-view" SYSTEM "view pics/Viper"}
Pic:
             _____
         ___/O   O\____
        / O        O   \
        \______________/
   -===|____\///\\\/_____
       \----------------/
        \______________/  \/
         /\__________/    //
  >=o\  // //\\   || \\  //
     \\o/ //  \o  ||  \o//
         //    || ||
     /o==o     |o \o==o   LS
    //         //     \\
    /\        //       /\   Arakyd Viper Probe Droid
              /\                 - Front View -

@ENDNODE

