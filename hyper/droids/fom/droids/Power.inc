@DATABASE Power.inc
@NODE "Power"

Power Droids


Name: 
 GONK
Model:
 EG-6 Powerdroid
Information:
 A power droid is a mobile power generator. Carrying an energy-
 production generator in its body, the droid is capable of 
 locomotion on two thick articulated legs. Its primaly function is
 to provide energy for ships, vehicles, mechanical devices and
 other droids.
Photo:
 @{"front-view" SYSTEM "view pics/GONK"}


Model:
 MPP-7 Power Droid
Pic:
      .=========.
     /:/:|'| | \ \
    |::' "" "" "" k
    |::  .-.  |=| |)
    |:  ( " )     f
    |:--.`+\\  o' |
    | ()+  \.\ "  |
     \_\_|_|>]>/_/
           /./
          ///   MPP-7 Power Droid
    LS   /_K__    - Side View -
        [.---[]
  """""""""""""""""""

@ENDNODE

