Security Droids

Name:
 Bodyguard Droid
Model: 
 B4 Bodyguard Droid
Pic:
           ____
          / ___\
         |: =O =O
         |:: __ |
          \_/LLL\
    __ __./:__:\.__ __
   (%%i \ |<__>| / i%%)
   |--|:/\/ :: \/\:|--|
   |  |:  :====:  :|  |
  .':.'Y-" |::| "-Y`.:`.
  |__| | : |__|.-.| |__|
  (%%) | : /++\`-'! (%%)
   \  \|n._\++/_.n| /  /
    \ xT::::--::::T/  /
     \Xl-. `""' .-lXX'
       |: \    / :|
       |:  i--i  :|
       |:  |  |  :| LS
       |___|  |__;|
       P%%%Y  P%%%Y
       b%%%d  b%%%d   B4 Bodyguard Droid
       |   |  |   |     - Front View -


Model:
 DEX 1 Security Sentinel
Pic:
         ____
     ===|\   |
        |/___|
          ||
     [] __||__
      \/ o   o|
      / o .= o| LS
     / o  || o|
    / o   || o|
   / o    `= o|
  /___________|  DEX 1 Security Sentinel
    (__)  (__)        - Side View -


Model:
 DEX 2 Security Sentinel
Pic:
         .-----.
     ===/______|
          `=='
          _||_
        ___||__
  =====/       `.
      / o | _ o | LS
     / o  ||  o |
    / o   ||  o |
   / o    ||_ o |
  <X______|_____|  DEX 2 Security Sentinel
   \HHHHHHHHHHHH|       - Side View -


