@DATABASE Astromech.inc
@NODE "Astromech"

Astromech Droids


Name:
 R1-G4
Model:
 Industrial Automaton R1 Astromech Droid
Information:
 An ancient astromech droid that is outdated compared to the
 new R2 astromechs. R1-G4was claimed by Jawa scanvengers
 when its owner, a smuggler, fled Mos Eisley after a run-in with
 bounty hunters.


Name: 
 R2-D2
Model: 
 Industrial Automaton R2 Astromech Droid
Sex:
 masculine programming
Height:
 0.96 meter
Skills:
 Computer Programming & Repair
 Starship Repair
Equipped with:
 Three wheeled legs (one retractable)
 Two retractable arms; a heavy grasper and one suited for fine work
 Extendable video sensor
 Small electric arc welder
 Smal circular saw
 Video display screen
 Holograph projector
 Fire extinguisher
Photo:
 @{"front-view" SYSTEM "view pics/r2d2"}
Pic:
         _____
       .'/L|__`.
      / =[_]O|` \
      |"+_____":|
    __:='|____`-:__
   ||[] ||====| []||
   ||[] | |=| | []||
   |:||_|=|U| |_||:|
   |:|||]_=_ =[_||:| LS
   | |||] [_][]C|| |
   | ||-'"""""`-|| |
   /|\\_\_|_|_/_//|\
  |___|   /|\   |___|   R2 Astromech Droid
  `---'  |___|  `---'     - Front View -
         `---'


Name:
 R5-D4
Model: 
 Industrial Automaton R5 Astromech Droid
Height:
 1 meter
Information:
 An astromech utility droid programmed in computer repair and
 information retrieval. It specialized in starship maintenance and
 can operate in hostile environments.
Photo:
 @{"front-view" SYSTEM "view pics/R5-D4"}



@ENDNODE

