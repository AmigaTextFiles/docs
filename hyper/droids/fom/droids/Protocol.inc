@DATABASE Protocol.inc
@NODE "Protocol"

Protocol Droids


Name: 
 4-LOM
Model:
 Industrial Automation 4-LOM Protocol Droid
Height:
 1.6 meters
Information:
 Rogue droid with humanoid body and inectoid head. One of
 the bounty hunters contracted by Darth Vader to track down
 the Millennium Falcon and its crew after they escaped the
 Imperial assault on the ice planet Hoth.
Photo:
 @{"front-view" SYSTEM "view pics/4-LOM"}


Name:
 C-3PO
Model:
 Cybot Galactica 3PO Human-Cyborg Relations Droid
Sex:
 masculine programming
Height:
 1.67 meters
Weight:
 50 kilograms
Skills:
 Languages
 Cultures
Equipped with:
 Vocabulator speech/sound system
 Broad-band antenna receiver
 AA-1 VerboBrain
 TranLang III Communication module (can access up to 
 seven million different languages)
Photo:
 @{"front-view" SYSTEM "view pics/C3PO2"}


@ENDNODE

