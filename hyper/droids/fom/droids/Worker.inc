@DATABASE Worker.inc
@NODE "Worker"

Worker Droids


Name:
 8D8
Information:
 The 8D8 series was designed to work  in smelting factories. 8D8s are
 tough and rugged, and tend to be rather crude and simple in
 personality. They resent being inferior to droids with more capability
 and often bully them when they can.
Photo:
 @{"front-view" SYSTEM "view pics/8DA"} 


Name:
 B1 Worker Droid
Model:
  AccuTronics B1 Worker Droid
Height:
 1.5 meters
Skills:
 Lifting
 Stamina
Equipped with:
 Suction/ magnetic-tipped digits
 Retractable third leg
 Visual spectrum scanners
Photo:
 @{"side-view" SYSTEM "view pics/B1"}


Name:
 Loader Droid
Photo:
 @{"front-view" SYSTEM "view pics/loaderdroid"}


@ENDNODE

