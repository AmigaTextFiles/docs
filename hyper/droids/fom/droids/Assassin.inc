@DATABASE Assassin.inc
@NODE "Assassin"

Assassin Droids


Name:
 Assassin Droid
Model:
 Eliminator 434 (manufactorer unknown)
Height:
 1.8 meters
Skills:
 Blaster
 Search
Weapons:
 Blaster Cannon
 Concussion Missile Launcher
Photos:
 @{"front/side-view" SYSTEM "view pics/Eli-1"}
 @{"front-view     " SYSTEM "view pics/Eli-2"}


Name:
 Assault
Model:
 "Assault" Assassin Droid 
Pic:
              ________
             /  ____  \
            /__/####\__\
     .-._.----.______.----._.-.
    /:  \H\  ::::        /H/   \
   /___ |_|______  ______|_| ___\
   |:: || |------\/------| ||   |
   |: |`' |  ::::||      | `'|  |
   |__|   |_  `::||     _|   |__|
    |||    |   ::||     |    |||
    |||    |__ ::||   __|    |||  LS
   _|_|_     |`--'`--'|     _|_|_
   |___|     [========]     |___|
   /|| |.---._|__  __|_.---.| ||\
  / || ||HHH|___/  \___|HHH||:|| \
  | || ||HHH|  `----'  |HHH||:|| |
  |_||_||_  |          |  _||_||_|
    ||   |  |          |  |   ||
    `'   |  |          |  |   `'   "Assault" 5 Assassin Droid
         |  |          |  |              - Front View -


Name:
 EV-9D9
Information:
 One of many droids under service to Jabba the Hutt. She was
 in charge of cyborg operations and oversaw all of the other
 droids in Jabba´s crowded stables.


Name:
 IG-88
Model:
 Holowan Mechanicals IG-88 Assassin
Sex:
 Masculine programming
Height:
 2 meters
Weapons:
 Blaster rifle and other weapons
Information:
 The IG line of assassin droids were programmed by Holowan
 scientists who maximized each droid´s freedom of action and
 combat potential. When activated, five prototype droids killed
 almost two dozen Holowans and escaped. A fearsome bounty
 hunter, IG-88 ist the most notorious IG assassin droid.
Photo:
 @{"front-view" SYSTEM "view pics/IG-88"}

Name:
 Intruder
Model:
 "Intruder" Assasin Droid
Pic:
         .-------.
        /.\:::::/.\
      .'.' |_O_| `.`.
     =================
       []. """"" .[]
          \[|||]/
           "---"              .-------.
                             /.\:::::/.\
                           .'.' |_O_| `.`.
                          =================
      ____________________/ []. """"" .[] \__
     /                   / / < \[|||]/ > \ \ \
    /   ...........      \ `    "---"    ' /  \   "Intruder" Assassin Droid
   /   `:::::::::::'                           \       - Front View -
  /_____________________________________________\
  |_____________________________________________| LS

        Hover-mode           Spider-mode
@ENDNODE



