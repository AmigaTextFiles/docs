@DATABASE Mining.inc
@NODE "Mining"

Mining Droids


Model:
 IMS Mining Droid 
Pic:
                              ___
                             /_//
       _________________   _//_
    __/-----------+-----\/\___O\
   /  /    \     _|_          \ \
  /__/______\___/:::\__  //######
  \__  ___    | \:::/::\//__|___/
     \/___|---+-----\::/__  |__/
     ///\/\___|  ___/::\  \/
     \\\/\/ __\/____\::/   \
        \/ /::\\____/  \  __\      _________
        | |::::|\  /    \/::\\___|/  |      \
       /|__\::/__\/      \::/     \0_|=======\
      / // \_/   \        \______ /<___________
      \_/    \/   \              |\_____|_____/
              \/ __\
               \/ //\_    LS
                \//_/ |
                |/---+'
                /____|__
               /        \_
              /\0_________\     IM2 Mining Droid
              \/===========      - Side View -


Model:
 Lin Demolitionmech Mining Droid
Information:
 The demolition droid is used to lay and fire explosive
 charges in commercial mining operations. Its convex 
 shell is plated with industrial durasteel and is designed
 to absorb the blast of a misfired explosive. Military models
 lay and defuse mines.

@ENDNODE

