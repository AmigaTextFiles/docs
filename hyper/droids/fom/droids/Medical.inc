@DATABASE Medical.inc
@NODE "Medical"

Medical Droids


Name:
 2-1B
Model:
 Geentech Too-Onebee Medical Droid
Height:
 1.5 meters
Weight:
 75 kilograms
Skills:
 Medicine
 Alien Races
Equipped with:
 Medical diagnostic computer
 Analytic computer
 Various surgical attachments
Information:
 One of the older, but most successful surgical droids.
 Simply-constructed, Too-Onebee droids posses uncanny
 perception and talent. They are sought after by military
 units. Many serve voluntarily with the Rebel Alliance.
Photo:
 @{"front-view" SYSTEM "view pics/Medicaldroid"}
Pic:
              .------.
            .'::::::' `.
            |: __   __ |
            | <__] [__>|
            `-.  __  .-'
              | |==| |
              | |==| |
           __.`-[..]-'\__
    _.--:""      ||   _``:::--._
   | |  |.      .:'  (o) ::|  | |
   |_|  |::..  // _       :|  |_|
    ===-|:''' // /.\       |-===\
    |_| `:___//_|[ ]|_____.' |_| )
    l=l   |\V/_=======_==|   l=l/
  .-l=l   |`'==/=="======|  /|.:
  | l l   |=="======\=_==| `-T l
  `.l_l   |==============|   l_l
    [_]  [__][__]____[_]__]  [_]
    \\\ .'.--.- --   --. .`. |||.
    \\\\| |  |    |    |  || ||||
     \\\\   .'    |    |  |`.||||   2-1B Medical Droid
      \\\\  |  LS |    `.   |||||     - Front View -


Name:
 FX-7
Information:
 Medical assistant droid that aids surgeons, found mostly in
 service to the Rebel Alliance. Equipped with sophisticated
 appendages and programmed for medical diagnoses and
 procedures.
Photo:
 @{"side-view" SYSTEM "view pics/Medicaldroid"}


@ENDNODE


