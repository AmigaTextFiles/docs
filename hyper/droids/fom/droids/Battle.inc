@DATABASE Battle.inc
@NODE "Battle"

Battle Droids


Model:
 Arakyd XR-85 Tank Droid
Photo:
 @{"side-view" SYSTEM "view pics/Tank"}


Model:
 ADM-12 Patrol Bot
Pic:
       .-"""-.
       | : : |
      / ===== \
      [       ]
       "-[#]-"
         T T           ()
         | |           ll
       _ | | _         ll
    .-| |\_/| |-.      ll
   /  |.:::::.|  \     lX
  /  <>+:[:]:+<>  |   /ll
  |.-Y-+%:::%+-Y-.\  //ll
  || | |;---;| |  \\// ll
  || | |:::::| |   \Y
  ||_| |:::::| |_
  ||#\u(""""")u/# LS
  ||# :||  :|| :#
  X'#__|`._.'|__#
    | :|     | :|   ADM-12 Patrol Bot
    | :|     | :|    - Front View -


Name:
 Imperial AP-1-C Attack Droid
Model:
 Armored Platform, model 1, Command)
Information:
 Imperial AP-1-C Attack Droids are among the newest combat
 units created by Arakyd, makers of the infamous Imperial probot.
 They are deadly against lightly armed infantry troops, thanks to
 their repeating blaster, but they serve an essential command
 duty by coordinating the functions of the AP-2 and AP-3 models
 and by feeding targeting data through a remote computer link
 with the other units. Any New Republic units that find a way to
 interfere with the broadcast data-link will have a much higher
 chance of defeating these units in combat.
Photo:
 @{"front-view" SYSTEM "view pics/AP-1"}


Name:
 Imperial AP-2 Attack Droid
Model:
 Armored Platform-2
Information:
 The AP-2 Attack Droid is the cornerstone of the Empire´s new
 anti-infantry assault droid team. Equipped with rapid-fire light
 repeating blasters on a rotating ´head turret´ and independently
 rotating heavy blaster rifles, the AP-2 is capable of single-
 handedly taking on nearly a whole squad of Republic soldiers.
 A pair of micro-grenade launchers installed in the lower arms
 round out the AP-2´s weaponry.
Photo:
 @{"front-view" SYSTEM "view pics/AP-2"}


Name:
 Imperial AP-3 Attack Droid
Model:
 Assault Platform-3
Information:
 The Imperial AP-3 Attack Droid looks like an astromech droid
 equipped with missile racks. The AP-3 unit trationally has a rear
 assault postion and uses its assault rockets and micro-proton-
 torpedos to blast vehicles and large numbers of enemy troops.
 While it is slow when moving on its wheeled legs, a repulsorlift
 drive unit at the base of its body allows it to move across the
 battlefield when summoned by AP-1-C Attack Droids.
Photo:
 @{"front-view" SYSTEM "view pics/AP-3"}


@ENDNODE

