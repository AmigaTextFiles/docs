@DATABASE Explorer.inc
@NODE "Explorer"

Explorer Droids

Name:
 Explorer Droid
Model:
 LesTech Explorer Droid
Height: 
 1.3 meters
Weight:
 165 kilograms
Skills:
 Planetary Systems
 Survival
 Search
Equipped with:
 Seismic sensors
 Motive (movement) sensors
 Electromagnetic sensors
 Visual and infrared range sensors
 Radiation sensors
 Two arms: heavy grasper and fine manipulator
 Holocam
 Specimen hopper (holds 5 kilos)
 Treads
Photo:
 @{"side-view" SYSTEM "view pics/LesTech"}
Pic:
     ________
  __/________\_
      =####oo
    _/  ()\\
   /____\  \`-.
   |___ |\  \ |
   /\   |_\  \/___ __
  /\/\ +|  \______X--
  \/ /\ |   / ~-.__~~
     \/##### ~-.X--
       =()===    ~~
  LS  _/  _|_
    _/ .-~O\ \
   /.-~_____`.\   LessTech Explorer Droid
   (O________O)        - Side View -


@ENDNODE

